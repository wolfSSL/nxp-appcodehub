## west.yml
```yaml
manifest:
  defaults:
    remote: zephyrproject-rtos

  remotes:
    - name: zephyrproject-rtos
      url-base: https://github.com/zephyrproject-rtos
    - name: wolfssl
      url-base: https://github.com/wolfssl
    - name: wolfssh
      url-base: https://github.com/wolfssl
    - name: wolfmqtt
      url-base: https://github.com/wolfssl
    - name: wolftpm
      url-base: https://github.com/wolfssl
    - name: wolfboot
      url-base: https://github.com/wolfssl

  projects:
    - name: zephyr
      remote: zephyrproject-rtos
      revision: v4.4.0
      import:
        - name-allowlist:
          - hal_nxp
          - cmsis
          - cmsis_6
          - fatfs
          - segger
    - name: wolfssl
      path: modules/crypto/wolfssl
      revision: v5.9.1-stable
      remote: wolfssl
    - name: wolfssh
      path: modules/lib/wolfssh
      revision: v1.4.22-stable
      remote: wolfssh
    - name: wolfmqtt
      path: modules/lib/wolfmqtt
      revision: v2.0.0
      remote: wolfmqtt
    - name: wolftpm
      path: modules/lib/wolftpm
      revision: v3.10.0
      remote: wolftpm
    - name: wolfboot
      path: modules/bootloader/wolfboot
      revision: v2.8.0
      remote: wolfboot
```
